// This file was generated from a template. Edit it to match your keyboard.
// See https://zmk.dev/docs/development/hardware-integration/new-shield for more
// instructions.

#include "tsungyu_lily58.dtsi"

&kscan {
    // Replace these comments with the GPIO pins in the matrix for the left side.
    // See https://zmk.dev/docs/development/hardware-integration/new-shield#shield-overlays
    col-gpios
        = <&xiao_d 0 GPIO_ACTIVE_HIGH>   /* COL0 */
        , <&xiao_d 1 GPIO_ACTIVE_HIGH>   /* COL1 */
        , <&xiao_d 2 GPIO_ACTIVE_HIGH>   /* COL2 */
        , <&xiao_d 3 GPIO_ACTIVE_HIGH>   /* COL3 */
        , <&xiao_d 10 GPIO_ACTIVE_HIGH>  /* COL4 */
        , <&xiao_d 5 GPIO_ACTIVE_HIGH>   /* COL5 */
        ;
};
